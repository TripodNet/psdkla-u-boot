## board/ti/dra7xx/Kconfig
```kconfig
if TARGET_DRA7XX_EVM

config SYS_BOARD
	default "dra7xx"

config SYS_VENDOR
	default "ti"

config SYS_CONFIG_NAME
	default "dra7xx_evm"

config TARGET_DRA7XX_EVM_VISION
        bool "Vision daughter card support"

source "board/ti/common/Kconfig"

endif
```
